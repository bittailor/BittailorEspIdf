## BtApps/BtBleAdvertisementsGateway/main/Kconfig.projbuild
```kconfig
menu "BT MIJIA Gateway"

    config BT_BLE_ADVERTISEMENTS_GATEWAY_WIFI_SSID
        string "WiFi SSID"
        default "mySsid"
        help
            SSID (network name) for the BT MIJIA Gateway to connect to.

    config BT_BLE_ADVERTISEMENTS_GATEWAY_WIFI_PASSWORD
        string "WiFi Password"
        default "myPassword"
        help
            WiFi password (WPA or WPA2) for the BT MIJIA Gateway to use.

    config BT_BLE_ADVERTISEMENTS_GATEWAY_MQTT_URI
        string "MQTT Broker URI"
        default "mqtt://broker.shiftr.io"
    
    config BT_BLE_ADVERTISEMENTS_GATEWAY_MQTT_CLIENT_ID
    	string "MQTT client id"
    	default "esp32-fw"
    
    config BT_BLE_ADVERTISEMENTS_GATEWAY_MQTT_USERNAME
        string "MQTT username"
        default "myMqttUsername"
        
    config BT_BLE_ADVERTISEMENTS_GATEWAY_MQTT_PASSWORD
        string "MQTT password"
        default "myMqttPassword"

endmenu
```

## BtApps/BtSketchAtcMi/sdkconfig.defaults
```kconfig
CONFIG_COMPILER_CXX_EXCEPTIONS=y
CONFIG_COMPILER_CXX_EXCEPTIONS_EMG_POOL_SIZE=0
CONFIG_COMPILER_CXX_RTTI=y

CONFIG_ESPTOOLPY_FLASHSIZE_4MB=y
CONFIG_ESPTOOLPY_FLASHSIZE="4MB"

CONFIG_PARTITION_TABLE_CUSTOM=y
CONFIG_PARTITION_TABLE_CUSTOM_FILENAME="partitions_custom.csv"
CONFIG_PARTITION_TABLE_FILENAME="partitions_custom.csv"

CONFIG_BT_ENABLED=y
CONFIG_BTDM_CTRL_MODE_BLE_ONLY=y
CONFIG_BT_NIMBLE_ENABLED=y
```

## BtApps/BtSketchEPaper/main/Kconfig.projbuild
```kconfig
menu "BT Alarm Clock"

    config BT_ALARM_CLOCK_WIFI_SSID
        string "WiFi SSID"
        default "mySsid"
        help
            SSID (network name) for the Alarm Clock to connect to.

    config BT_ALARM_CLOCK_WIFI_PASSWORD
        string "WiFi Password"
        default "myPassword"
        help
            WiFi password (WPA or WPA2) for the Alarm Clock to use.

    config BT_ALARM_CLOCK_MQTT_URI
        string "MQTT Broker URI"
        default "mqtt://broker.shiftr.io"
    
    config BT_ALARM_CLOCK_MQTT_CLIENT_ID
    	string "MQTT client id"
    	default "esp32-fw"
    
    config BT_ALARM_CLOCK_MQTT_USERNAME
        string "MQTT username"
        default "myMqttUsername"
        
    config BT_ALARM_CLOCK_MQTT_PASSWORD
        string "MQTT password"
        default "myMqttPassword"

endmenu
```

## BtApps/BtSketchOta/main/Kconfig.projbuild
```kconfig
menu "BT Sketch OTA"

    config BT_SKETCH_OTA_WIFI_SSID
        string "WiFi SSID"
        default "mySsid"
        help
            SSID (network name) for the BT Sketch OTA to connect to.

    config BT_SKETCH_OTA_WIFI_PASSWORD
        string "WiFi Password"
        default "myPassword"
        help
            WiFi password (WPA or WPA2) for the BT Sketch OTA to use.

    config BT_SKETCH_OTA_MQTT_URI
        string "MQTT Broker URI"
        default "mqtt://broker.shiftr.io"
    
    config BT_SKETCH_OTA_MQTT_CLIENT_ID
    	string "MQTT client id"
    	default "esp32-fw"
    
    config BT_SKETCH_OTA_MQTT_USERNAME
        string "MQTT username"
        default "myMqttUsername"
        
    config BT_SKETCH_OTA_MQTT_PASSWORD
        string "MQTT password"
        default "myMqttPassword"

endmenu
```

## BtCmps/components/BtCore/Kconfig
```kconfig
menu "Bittailor Core"

    menu "WiFi"
        config BITTAILOR_WIFI_SSID
            string "WiFi SSID"
            default "mySsid"
            help
                WiFi SSID (network name).
    
        config BITTAILOR_WIFI_PASSWORD
            string "WiFi Password"
            default "myPassword"
            help
                WiFi password (WPA or WPA2).
    endmenu

    menu "MQTT"
        config BITTAILOR_MQTT_URI
            string "MQTT Broker URI"
            default "mqtt://mybroker.io"
            
        config BITTAILOR_MQTT_USE_USERNAME_AND_PASSWORD
                bool "MQTT use username and password."
                default y
                help
                    MQTT use username and password..

        config BITTAILOR_MQTT_USERNAME
            string "MQTT username"
            default "myMqttUsername"
            depends on BITTAILOR_MQTT_USE_USERNAME_AND_PASSWORD
            
        config BITTAILOR_MQTT_PASSWORD
            string "MQTT password"
            default "myMqttPassword"
            depends on BITTAILOR_MQTT_USE_USERNAME_AND_PASSWORD
        
    endmenu

endmenu
```

## BtCmps/sdkconfig.defaults
```kconfig
CONFIG_COMPILER_CXX_EXCEPTIONS=y
CONFIG_COMPILER_CXX_EXCEPTIONS_EMG_POOL_SIZE=0
CONFIG_COMPILER_CXX_RTTI=y

CONFIG_ESPTOOLPY_FLASHSIZE_4MB=y
CONFIG_ESPTOOLPY_FLASHSIZE="4MB"

CONFIG_ESP_MAIN_TASK_STACK_SIZE=20480
CONFIG_MAIN_TASK_STACK_SIZE=20480
```
